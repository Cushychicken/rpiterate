## br-external/packages/Config.in
```kconfig
menu "External packages"

source "$BR2_EXTERNAL_RPTR8_PATH/packages/helloworld-example/Config.in"
source "$BR2_EXTERNAL_RPTR8_PATH/packages/hellopython-example/Config.in"

endmenu
```

## br-external/packages/hellopython-example/Config.in
```kconfig
config BR2_PACKAGE_HELLOPYTHON_EXAMPLE
	bool "hellopython-example"
	depends on BR2_PACKAGE_PYTHON3
	help
	  A simple Hello World Python program designed for cross-compilation
	  to Raspberry Pi 4, suitable for use as a Buildroot package.

	  https://github.com/Cushychicken/hellopython-example
```

## br-external/packages/helloworld-example/Config.in
```kconfig
config BR2_PACKAGE_HELLOWORLD_EXAMPLE
	bool "helloworld-example"
	help
	  A simple Hello World C program designed for cross-compilation
	  to Raspberry Pi 4, suitable for use as a Buildroot package.

	  https://github.com/Cushychicken/helloworld-example
```
